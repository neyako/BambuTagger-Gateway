#ifdef ESP32
#include <WiFi.h>
#include <ESPmDNS.h>
#else
#include <ESP8266WiFi.h>
#include <ESP8266mDNS.h>
#endif
#include <WiFiUdp.h>
#include <ArduinoOTA.h>
#include <lwip/igmp.h>
#ifdef ESP32
#include <esp_wifi.h>
#include <esp_task_wdt.h>
#include <esp_heap_caps.h>
#include <mbedtls/platform.h>
#endif

#include "config.h"
#include "ui/webconfig.h"
#include "mqtt_bridge.h"
#include "tcp_proxy.h"

MqttBridge mqtt;
TcpProxy camProxy("camera", CAM_LOCAL_PORT, PRINTER_HOST_DFLT, CAM_PRINTER_PORT, MAX_TCP_CLIENTS);
TcpProxy ftpsProxy("ftps", FTPS_LOCAL_PORT, PRINTER_HOST_DFLT, FTPS_PRINTER_PORT, MAX_TCP_CLIENTS);

// Port 8883 is handled by MqttBridge as a TLS-wrapped MQTT server using the
// self-signed cert (with Bambu OIDs) generated by certgen. Port 1883 is
// plain MQTT for local tools. Both bridge to the printer via the upstream
// PubSubClient connection.



// SSDP (Simple Service Discovery Protocol) responder for Bambu Lab auto-detection.
// Bambu Studio discovers printers via SSDP on UDP port 2021.
// Real printers broadcast NOTIFY every ~10s to 239.255.255.250:2021.
// They also respond to M-SEARCH sent to multicast 239.255.255.250:2021.
static const uint16_t SSDP_PORT = 2021;
static WiFiUDP _ssdpUdp;
static bool _ssdpReady = false;
static unsigned long _ssdpLastNotify = 0;
char _displayName[32] = "BambuTagger-Gateway";

static void buildSsdpmessage(const GatewayConfig *cfg, char *buf, size_t len, bool isResponse) {
  IPAddress ipa = WiFi.localIP();
  char ip[16];
  snprintf(ip, sizeof(ip), "%d.%d.%d.%d", ipa[0], ipa[1], ipa[2], ipa[3]);
  const char *serial = cfg->gatewaySerial;
  if (isResponse) {
    snprintf(buf, len,
      "HTTP/1.1 200 OK\r\n"
      "Server: UPnP/1.0\r\n"
      "Date: Thu, 26 Jun 2025 00:00:00 GMT\r\n"
      "Location: %s\r\n"
      "ST: urn:bambulab-com:device:3dprinter:1\r\n"
      "EXT: \r\n"
      "USN: %s\r\n"
      "Cache-Control: max-age=1800\r\n"
      "DevModel.bambu.com: %s\r\n"
      "DevName.bambu.com: %s\r\n"
        "DevConnect.bambu.com: lan\r\n"
        "DevBind.bambu.com: free\r\n"
        "Devseclink.bambu.com: secure\r\n"
      "DevInf.bambu.com: wlan0\r\n"
      "DevVersion.bambu.com: 01.07.00.00\r\n"
      "DevCap.bambu.com: 1\r\n"
      "\r\n",
      ip, serial, cfg->printerModel, _displayName);
    } else {
      snprintf(buf, len,
        "NOTIFY * HTTP/1.1\r\n"
      "Host: 239.255.255.250:2021\r\n"
      "Server: UPnP/1.0\r\n"
      "Location: %s\r\n"
      "NT: urn:bambulab-com:device:3dprinter:1\r\n"
      "NTS: ssdp:alive\r\n"
      "USN: %s\r\n"
      "Cache-Control: max-age=1800\r\n"
      "DevModel.bambu.com: %s\r\n"
      "DevName.bambu.com: %s\r\n"
        "DevConnect.bambu.com: lan\r\n"
        "DevBind.bambu.com: free\r\n"
        "Devseclink.bambu.com: secure\r\n"
      "DevInf.bambu.com: wlan0\r\n"
      "DevVersion.bambu.com: 01.07.00.00\r\n"
      "DevCap.bambu.com: 1\r\n"
      "\r\n",
        ip, serial, cfg->printerModel, _displayName);
  }
}

// Start SSDP responder: bind UDP port 2021, join the SSDP multicast group,
// and respond to M-SEARCH queries from Bambu Studio.
static void startSSDP(const GatewayConfig *cfg) {
  if (_ssdpReady) return;
  if (WiFi.localIP() == IPAddress(0, 0, 0, 0)) return;

  IPAddress mcast(239, 255, 255, 250);
  if (_ssdpUdp.beginMulticast(mcast, SSDP_PORT)) {
    Serial.println("SSDP: bound to port 2021, joined multicast 239.255.255.250");
  } else {
    // fallback: bind unicast only, send NOTIFY on broadcast
    if (!_ssdpUdp.begin(SSDP_PORT)) {
      Serial.println("SSDP: failed to bind port 2021");
      return;
    }
    Serial.println("SSDP: WARNING multicast join failed — NOTIFY-only mode");
  }

  _ssdpReady = true;
  _ssdpLastNotify = 0;
  Serial.printf("SSDP: listening on UDP port %d\n", SSDP_PORT);
}

static void stopSSDP() {
  if (_ssdpReady) {
    _ssdpUdp.stop();
    _ssdpReady = false;
  }
}

// Handle incoming SSDP messages (M-SEARCH) and send periodic NOTIFY.
static void loopSSDP(const GatewayConfig *cfg) {
  if (!_ssdpReady) return;

  unsigned long now = millis();

  // Periodic NOTIFY broadcast (real printers send every ~10s)
  if (now - _ssdpLastNotify > 10000) {
    _ssdpLastNotify = now;
    char buf[512];
    buildSsdpmessage(cfg, buf, sizeof(buf), false);
    _ssdpUdp.beginPacket(IPAddress(255, 255, 255, 255), SSDP_PORT);
    _ssdpUdp.write((const uint8_t *)buf, strlen(buf));
    _ssdpUdp.endPacket();
  }

  // Check for incoming M-SEARCH packets
  int packetSize = _ssdpUdp.parsePacket();
  if (packetSize > 0) {
    char buf[512];
    int len = _ssdpUdp.read(buf, sizeof(buf) - 1);
    if (len > 0) {
      buf[len] = '\0';
      String msg(buf);

      // Respond if this is an M-SEARCH for Bambu printers or ssdp:all
      if (msg.indexOf("M-SEARCH") >= 0 &&
          (msg.indexOf("bambu") >= 0 ||
           msg.indexOf("ssdp:all") >= 0 ||
           msg.indexOf("upnp:rootdevice") >= 0)) {
        char resp[512];
        buildSsdpmessage(cfg, resp, sizeof(resp), true);
        _ssdpUdp.beginPacket(_ssdpUdp.remoteIP(), _ssdpUdp.remotePort());
        _ssdpUdp.write((const uint8_t *)resp, strlen(resp));
        _ssdpUdp.endPacket();
        Serial.printf("SSDP: responded to M-SEARCH from %s\n",
                      _ssdpUdp.remoteIP().toString().c_str());
      }
    }
  }
}

// WiFi policy. Without saved credentials the setup AP stays up. With them, STA
// retries forever and the setup AP is a bounded fallback that is never on while
// STA is connected. The core's auto-reconnect alone is not enough: it stops for
// good on reasons outside its whitelist (e.g. AUTH_FAIL from a booting router).
// Fixed, no backoff: one connect attempt failing right after the router returns
// (seen on hardware) must still leave a rejoin within ~1 minute.
#define STA_RETRY_MS       30000UL
#define AP_AFTER_BOOT_MS   (2 * 60000UL)    // not connected since boot (router slow, wrong password)
#define AP_AFTER_LOSS_MS   (10 * 60000UL)   // was connected, then lost
#define AP_WINDOW_MS       (5 * 60000UL)

static void apOn() {
  // Open for first-time setup; WPA2 with the admin password once one is set.
  const char *admin = webconfigGetConfig()->adminPass;
  if (!WiFi.softAP(GATEWAY_AP_SSID, admin[0] ? admin : GATEWAY_AP_PASS, GATEWAY_AP_CHANNEL)) {
    Serial.println("AP FAILED");
    return;
  }
  Serial.printf("AP: %s up at %s\n", GATEWAY_AP_SSID, WiFi.softAPIP().toString().c_str());
}

static void apOff() {
  WiFi.softAPdisconnect(true);  // back to STA-only
  Serial.println("AP: off");
}

static void wifiLoop() {
  const GatewayConfig *cfg = webconfigGetConfig();
  if (!cfg->stationSsid[0]) return;

  static unsigned long downSince = 0, lastTry = 0, apSince = 0;
  static bool everUp = false;
  unsigned long now = millis();
  bool apUp = WiFi.getMode() & WIFI_MODE_AP;

  if (WiFi.isConnected()) {
    everUp = true;
    downSince = lastTry = now;  // first retry after a loss is left to the core
    if (apUp) apOff();
    return;
  }

  if (now - lastTry >= STA_RETRY_MS) {
    lastTry = now;
    Serial.printf("WiFi: retrying %s (status %d)\n", cfg->stationSsid, WiFi.status());
    WiFi.disconnect();
    WiFi.begin(cfg->stationSsid, cfg->stationPass);
  }

  if (!apUp && now - downSince >= (everUp ? AP_AFTER_LOSS_MS : AP_AFTER_BOOT_MS)) {
    apOn();
    apSince = now;
  } else if (apUp && now - apSince >= AP_WINDOW_MS) {
    apOff();
    downSince = now;  // STA keeps retrying; AP returns after another full wait
  }
}

#ifdef ESP32
// This core's mbedTLS allocates internal RAM only: ~48 KB per TLS session, so
// 3-4 TLS clients exhausted the heap and the printer link could not reconnect.
// Same as IDF's CONFIG_MBEDTLS_EXTERNAL_MEM_ALLOC: use PSRAM, internal fallback.
static void *tlsCalloc(size_t n, size_t size) {
  void *p = heap_caps_calloc(n, size, MALLOC_CAP_SPIRAM | MALLOC_CAP_8BIT);
  return p ? p : heap_caps_calloc(n, size, MALLOC_CAP_INTERNAL | MALLOC_CAP_8BIT);
}
#endif

// XIAO ESP32-S3: built-in LED on GPIO21, active LOW (LED_BUILTIN from variant).
#ifndef LED_BUILTIN
#define LED_BUILTIN 21
#endif

static void ledSetup() {
  pinMode(LED_BUILTIN, OUTPUT);
  digitalWrite(LED_BUILTIN, LOW);  // on during boot
}

static void ledLoop() {
  static unsigned long last = 0;
  unsigned long now = millis();
  unsigned long interval;

  bool staConfig = strlen(webconfigGetConfig()->stationSsid) > 0;
  bool staUp = WiFi.isConnected();
  MqttStatus st = ::mqtt.getStatus();

  if (!staUp && staConfig) {
    interval = 500;     // slow blink — WiFi connecting
  } else if (staUp && st != MQTT_UP) {
    interval = 100;     // fast blink — MQTT connecting
  } else {
    digitalWrite(LED_BUILTIN, HIGH);  // off — everything up
    return;
  }

  if (now - last >= interval) {
    last = now;
    digitalWrite(LED_BUILTIN, !digitalRead(LED_BUILTIN));
  }
}

void setup() {
  Serial.begin(115200);
  // ESP32-S3 native USB CDC needs time to enumerate before any output
  delay(3000);
  Serial.println("\n\nBambuTagger Gateway " VERSION);

  ledSetup();
#ifdef ESP32
  if (psramFound()) mbedtls_platform_set_calloc_free(tlsCalloc, free);
  Serial.printf("PSRAM: %u bytes\n", ESP.getPsramSize());
#endif

  // Load config first (EEPROM only, no lwIP needed)
  webconfigInit();
  GatewayConfig *cfg = webconfigGetConfig();

  // STA only when credentials are saved (wifiLoop opens the AP if STA stays
  // down); setup AP only when they are not.
  WiFi.persistent(false);  // retries must not rewrite NVS
  if (cfg->stationSsid[0]) {
    WiFi.mode(WIFI_STA);
    WiFi.setSleep(false);
    Serial.printf("Connecting to WiFi: %s\n", cfg->stationSsid);
    WiFi.begin(cfg->stationSsid, cfg->stationPass);
  } else {
    WiFi.mode(WIFI_AP);
    apOn();
    Serial.println("No station configured — AP only");
  }

  // Now start TCP servers (lwIP is initialized by WiFi in either mode)
  webconfigBegin();
  delay(1000);

  // apply runtime config to all bridges
  mqtt.begin(cfg);
  camProxy.setRemote(cfg->printerHost, CAM_PRINTER_PORT);
  ftpsProxy.setRemote(cfg->printerHost, FTPS_PRINTER_PORT);

  Serial.print("Printer: ");
  Serial.print(cfg->printerHost);
  Serial.print("  Serial: ");
  Serial.println(cfg->printerSerial);

  camProxy.begin();
  ftpsProxy.begin();
  Serial.printf("MQTT TLS server on port %d\n", MQTT_PRINTER_PORT);

  Serial.printf("Free heap: %u\n", ESP.getFreeHeap());

  // A hang anywhere in loop() now reboots instead of needing a power cycle.
  // 30 s covers the longest blocking call (upstream TLS connect, update check).
  esp_task_wdt_init(30, true);
  enableLoopWDT();
  Serial.println("Ready.");
}

static void startStationServices(GatewayConfig *cfg) {
  Serial.printf("Station connected — IP: %s  heap: %u\n",
    WiFi.localIP().toString().c_str(), ESP.getFreeHeap());
  Serial.printf("Web UI at http://%s\n", WiFi.localIP().toString().c_str());

  delay(500);
  // Rebind servers after WiFi mode switch (AP → STA) ensures listeners
  // are bound to the active station interface.
  mqtt.rebind();

  // Verify the MQTT server is listening on the station IP
  delay(100);
  WiFiClient selfTest;
  IPAddress local = WiFi.localIP();
  if (selfTest.connect(local, MQTT_LOCAL_PORT)) {
    Serial.printf("MQTT: self-test OK — connected to %s:%d\n",
      local.toString().c_str(), MQTT_LOCAL_PORT);
    selfTest.stop();
  } else {
    Serial.printf("MQTT: WARNING self-test FAILED — %s:%d unreachable\n",
      local.toString().c_str(), MQTT_LOCAL_PORT);
  }

  startSSDP(cfg);

  Serial.printf("After SSDP — heap: %u\n", ESP.getFreeHeap());

  char mdnsName[64];
  // Printer-like hostname: 3DP-<first 3 of gateway id>-<last 3 of gateway id>
  size_t gwl = strlen(cfg->gatewaySerial);
  snprintf(mdnsName, sizeof(mdnsName), "3DP-%.3s-%.3s",
    cfg->gatewaySerial,
    gwl >= 3 ? cfg->gatewaySerial + gwl - 3 : cfg->gatewaySerial);
  strlcpy(_displayName, mdnsName, sizeof(_displayName));
  if (MDNS.begin(mdnsName)) {
    MDNS.addService("bambu", "tcp", MQTT_PRINTER_PORT);
    MDNS.addServiceTxt((const char *)"bambu", (const char *)"tcp", (const char *)"product", (const char *)cfg->printerModel);
    // Same identity as SSDP: advertise the gateway, not the physical printer.
    MDNS.addServiceTxt((const char *)"bambu", (const char *)"tcp", (const char *)"serial", (const char *)cfg->gatewaySerial);
    MDNS.addServiceTxt((const char *)"bambu", (const char *)"tcp", (const char *)"fw_version", (const char *)VERSION);
    MDNS.addServiceTxt((const char *)"bambu", (const char *)"tcp", (const char *)"cloud", (const char *)"disable");
    MDNS.addServiceTxt((const char *)"bambu", (const char *)"tcp", (const char *)"usb", (const char *)"no");
  }

  ArduinoOTA.setHostname(mdnsName);
  if (cfg->adminPass[0]) ArduinoOTA.setPassword(cfg->adminPass);
  ArduinoOTA.onStart([]() { Serial.println("OTA: start"); });
  ArduinoOTA.onEnd([]() { Serial.println("OTA: end"); });
  // The upload runs inside loop() and can outlast the 30 s loop watchdog.
  ArduinoOTA.onProgress([](unsigned, unsigned) { esp_task_wdt_reset(); });
  ArduinoOTA.onError([](ota_error_t err) {
    Serial.printf("OTA: error %d\n", err);
  });
  ArduinoOTA.begin();

  Serial.printf("After MDNS+OTA — heap: %u\n", ESP.getFreeHeap());
}



void loop() {
  webconfigLoop();
  wifiLoop();

  // Debug AP status every 2 seconds
  static int lastStaCount = -1;
  static int lastMode = -1;
  static int lastStatus = -1;
  static unsigned long lastDbg = 0;
  unsigned long now = millis();
  int sc = WiFi.softAPgetStationNum();
  int mo = WiFi.getMode();
  int ws = WiFi.status();
  if ((sc != lastStaCount || mo != lastMode || ws != lastStatus || now - lastDbg > 5000) && now - lastDbg > 500) {
    lastStaCount = sc;
    lastMode = mo;
    lastStatus = ws;
    lastDbg = now;
    // Quiet once station is stably connected with AP off
    if (mo != 1 || ws != 3) {
      Serial.printf("mode=%d AP=%s sta=%d staCon=%d wl=%d heap=%u\n",
        mo, (mo == 2 || mo == 3) ? WiFi.softAPIP().toString().c_str() : "-",
        sc, WiFi.isConnected(), ws, ESP.getFreeHeap());
    }
  }

  // Start station services (MDNS, OTA, SSDP) on first station connection
  // Must happen before bridge loops so MDNS is available for hostname resolution
  GatewayConfig *cfg = webconfigGetConfig();
  static bool staServicesStarted = false;
  if (!staServicesStarted && WiFi.isConnected()) {
    staServicesStarted = true;
    startStationServices(cfg);
  }

  mqtt.loop();  // handles both port 1883 (plain) and 8883 (TLS)
  camProxy.loop();
  ftpsProxy.loop();
  ArduinoOTA.handle();
  ledLoop();

  loopSSDP(cfg);
}
